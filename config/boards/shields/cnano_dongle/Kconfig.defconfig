## config/boards/shields/cnano_dongle/Kconfig.defconfig
```kconfig
if SHIELD_CNANO_DONGLE

config ZMK_KEYBOARD_NAME
	default "Charybdis"

config ZMK_SPLIT_ROLE_CENTRAL
	default y

endif

if SHIELD_CNANO_DONGLE || SHIELD_CNANO_LEFT || SHIELD_CNANO_RIGHT

config ZMK_SPLIT
	default y
	
endif
```

## config/boards/shields/cnano_dongle/Kconfig.shield
```kconfig
config SHIELD_CNANO_DONGLE
	def_bool $(shields_list_contains,cnano_dongle)

config SHIELD_CNANO_LEFT
	def_bool $(shields_list_contains,cnano_left)

config SHIELD_CNANO_RIGHT
	def_bool $(shields_list_contains,cnano_right)
```

## config/west.yml
```yaml
manifest:
  remotes:
    - name: zmkfirmware
      url-base: https://github.com/petejohanson
    - name: urob
      url-base: https://github.com/urob
    - name: englmaxi
      url-base: https://github.com/englmaxi

    - name: badjeff
      url-base: https://github.com/badjeff

  projects:
    - name: zmk
      remote: zmkfirmware
      revision: feat/pointers-move-scroll
      import: app/west.yml
    - name: zmk-helpers
      remote: urob
      revision: main

    - name: zmk-dongle-display
      remote: englmaxi
      revision: main
    - name: zmk-pmw3610-driver
      remote: badjeff
      revision: main

    - name: zmk-split-peripheral-input-relay
      remote: badjeff
      revision: main
    - name: zmk-input-behavior-listener
      remote: badjeff
      revision: main

  self:
    path: config
```
